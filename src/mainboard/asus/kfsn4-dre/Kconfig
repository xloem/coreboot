## src/mainboard/asus/kfsn4-dre/Kconfig
```kconfig
if BOARD_ASUS_KFSN4_DRE

config BOARD_SPECIFIC_OPTIONS
	def_bool y
	select CPU_AMD_SOCKET_F_1207
	select DIMM_DDR2
	select DIMM_REGISTERED
	select NORTHBRIDGE_AMD_AMDFAM10
	select SOUTHBRIDGE_NVIDIA_CK804
	select SUPERIO_WINBOND_W83627THG
	select HAVE_OPTION_TABLE
	select HAVE_CMOS_DEFAULT
	select HAVE_ACPI_TABLES
	select LIFT_BSP_APIC_ID
	select BOARD_ROMSIZE_KB_1024
	select DRIVERS_XGI_Z9S
	select POWER_STATE_DEFAULT_ON_AFTER_FAILURE
	select SYSTEM_TYPE_SERVER
	select DRIVERS_I2C_W83793

config MEMLAYOUT_LD_FILE
	string
	default "src/mainboard/asus/kfsn4-dre/memlayout.ld"

config MAINBOARD_DIR
	string
	default "asus/kfsn4-dre"

config APIC_ID_OFFSET
	hex
	default 0x0

config MAINBOARD_PART_NUMBER
	string
	default "KFSN4-DRE"

config HW_MEM_HOLE_SIZEK
	hex
	default 0x100000

config MAX_CPUS
	int
	default 12

config MAX_PHYSICAL_CPUS
	int
	default 2

config HT_CHAIN_UNITID_BASE
	hex
	default 0x0

config HT_CHAIN_END_UNITID_BASE
	hex
	default 0x20

config IRQ_SLOT_COUNT
	int
	default 13

config CK804_PCI_E_X
	int
	default 1

config CK804_PCIE_PME_WAKE
	bool
	default y

config ONBOARD_VGA_IS_PRIMARY
	bool
	default y

config MAX_REBOOT_CNT
	int
	default 10

config ENABLE_APIC_EXT_ID
	bool
	default y

config SEABIOS_ADD_SERCON_PORT_FILE
	bool
	default y if PAYLOAD_SEABIOS

endif # BOARD_ASUS_KFSN4_DRE
```

## src/southbridge/nvidia/ck804/Kconfig
```kconfig
config SOUTHBRIDGE_NVIDIA_CK804
	bool
	select HAVE_USBDEBUG
	select IOAPIC
	select HAVE_POWER_STATE_AFTER_FAILURE
	# dasharo added BOOT_DEVICE_SUPPORTS_WRITES
	# dasharo added SOC_AMD_COMMON as # workaround for BIOSRAM needed in amd_mtrr.c

if SOUTHBRIDGE_NVIDIA_CK804

config EHCI_BAR
	hex
	default 0xfef00000

config CK804_USE_NIC
	bool
	default n

config CK804_USE_ACI
	bool
	default n

config CK804_PCI_E_X
	int
	default 4

config CK804B_PCI_E_X
	int
	default 4

config CK804_PCIE_PME_WAKE
	bool "Enable system wake on PCIe PME# signal"
	default n

config HPET_MIN_TICKS
	hex
	default 0xfa

endif
```
